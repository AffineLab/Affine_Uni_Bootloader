## targets/esp32s3/agent/main/Kconfig.projbuild
```kconfig
menu "Affine ESP32-S3 agent"
config AFFINE_AGENT_LOG_CDC
    bool "Mirror logs to a second CDC interface (test builds only)"
    default n
    depends on TINYUSB_CDC_COUNT >= 2
    help
        For boards whose USB-UART port cannot be connected together with the
        native port. Interface 0 stays the Uni protocol channel; logs are
        mirrored to CDC interface 1, and still go to UART0. Lines are dropped
        while no host drains them. Build with sdkconfig.logcdc.
endmenu
```

## targets/esp32s3/agent/sdkconfig.defaults
```kconfig
CONFIG_TINYUSB_CDC_ENABLED=y
# CONFIG_SPIRAM is not set
CONFIG_TINYUSB_CDC_COUNT=1
CONFIG_TINYUSB_CDC_RX_BUFSIZE=1024
CONFIG_TINYUSB_CDC_TX_BUFSIZE=1024
# CONFIG_TINYUSB_DESC_USE_ESPRESSIF_VID is not set
CONFIG_TINYUSB_DESC_CUSTOM_VID=0xAFF1
# CONFIG_TINYUSB_DESC_USE_DEFAULT_PID is not set
CONFIG_TINYUSB_DESC_CUSTOM_PID=0x52B6
CONFIG_TINYUSB_DESC_MANUFACTURER_STRING="Affine"
CONFIG_TINYUSB_DESC_PRODUCT_STRING="Affine Uni Bootloader ES3S"
CONFIG_TINYUSB_DESC_CDC_STRING="Uni protocol"
```

## targets/esp32s3/sdkconfig.defaults
```kconfig
CONFIG_IDF_TARGET="esp32s3"
CONFIG_ESPTOOLPY_FLASHSIZE_16MB=y
CONFIG_ESPTOOLPY_FLASHMODE_DIO=y
CONFIG_ESPTOOLPY_FLASHFREQ_40M=y
CONFIG_PARTITION_TABLE_CUSTOM=y
CONFIG_PARTITION_TABLE_CUSTOM_FILENAME="../partitions.csv"
CONFIG_BOOTLOADER_APP_ROLLBACK_ENABLE=y
# CONFIG_BOOTLOADER_APP_ANTI_ROLLBACK is not set
# CONFIG_SECURE_BOOT is not set
# CONFIG_SECURE_BOOT_V2_ENABLED is not set
# CONFIG_SECURE_FLASH_ENC_ENABLED is not set
CONFIG_ESP_CONSOLE_UART_DEFAULT=y
CONFIG_ESP_CONSOLE_SECONDARY_NONE=y
CONFIG_ESP_MAIN_TASK_STACK_SIZE=16384
CONFIG_COMPILER_OPTIMIZATION_SIZE=y
```

## targets/esp32s3/test_app/main/Kconfig.projbuild
```kconfig
menu "Affine ESP32-S3 test app"
config AFFINE_TEST_CRASH
    bool "Reset before confirming the app (rollback test)"
    default n
endmenu
```
